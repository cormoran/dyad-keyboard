## boards/shields/dyad/Kconfig.defconfig
```kconfig
if SHIELD_DYAD_RIGHT

config ZMK_KEYBOARD_NAME
    default "Dyad KB"

config ZMK_SPLIT_ROLE_CENTRAL
    default y

config PMW3610
    default y
config PMW3610_DISABLE_NCS
    default y
config ZMK_MOUSE
    default y

choice PMW3610_ORIENTATION
    default PMW3610_ORIENTATION_90
endchoice

config PMW3610_SCROLL_TICK
    default 40
config PMW3610_SMART_ALGORITHM
    default n

config PMW3610_INVERT_Y
    default y

config ZMK_SPLIT_BLE_CENTRAL_BATTERY_LEVEL_PROXY
   default y
config ZMK_SPLIT_BLE_CENTRAL_BATTERY_LEVEL_FETCHING
   default y

endif

if SHIELD_DYAD_LEFT || SHIELD_DYAD_RIGHT

config ZMK_SPLIT
    default y
config ZMK_BATTERY_REPORTING
    default y
endif
```

## config/west.yml
```yaml
manifest:
  remotes:
    - name: zmkfirmware
      url-base: https://github.com/zmkfirmware
    - name: cormoran
      url-base: https://github.com/cormoran
    - name: caksoylar
      url-base: https://github.com/caksoylar
  projects:
    - name: zmk
      remote: zmkfirmware
      revision: d0016b34f88b76bd0c1fb5964bbae9d1916dcf76
      import: app/west.yml
    - name: zmk-pmw3610-driver-without-ncs
      remote: cormoran
      revision: main
    - name: zmk-rgbled-widget
      remote: caksoylar
      revision: main
  self:
    path: config
```
